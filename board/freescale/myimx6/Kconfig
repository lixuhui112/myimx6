## board/freescale/myimx6/Kconfig
```kconfig
if TARGET_MYIMX6

config SYS_BOARD
	default "myimx6"

config SYS_VENDOR
	default "freescale"

config SYS_SOC
	default "mx6"

config SYS_CONFIG_NAME
	default "myimx6"

endif
```

## configs/myimx6_defconfig
```kconfig
CONFIG_SYS_EXTRA_OPTIONS="IMX_CONFIG=board/freescale/myimx6/mx6q_4x_mt41j128.cfg,MX6Q,SYS_USE_SPINOR"
CONFIG_ARM=y
CONFIG_TARGET_MYIMX6=y
CONFIG_DM=y
CONFIG_DM_THERMAL=y
```
